/*
 * HeartRateMonitor.cpp
 *
 *  Created on: 28/04/2013
 *      Author: roger
 */

#include "HeartRateMonitor.h"

static uint16_t myicon[] PROGMEM = {
	0x0000,0x0000,0x0000,0x0000,0x0841,0xffdf,0xffdf,0xffdf,0xffdf,0xffdf,0x0841,0x0000,0x0000,0x0000,0x0000,0x0000,0x0000,0x0841,0xffdf,0xffdf,0xffdf,0xffdf,0xffdf,0xffdf,0x0000,0x0000,0x0000,0x0000,
	0x0000,0x0000,0x0000,0xf79e,0xffdf,0xfa8a,0xf8c3,0xf8c3,0xf8c3,0xf9c7,0xe410,0xf79e,0x0000,0x0000,0x0000,0x0000,0xf79e,0xffdf,0xfa08,0xf8c3,0xf8c3,0xf8c3,0xfa49,0xffdf,0xf79e,0x0841,0x0000,0x0000,
	0x0000,0x0000,0xf79e,0xfb8e,0xf945,0xf841,0xf800,0xf800,0xf800,0xf841,0xf8c3,0xfa49,0xef5d,0x0000,0x0000,0xef5d,0xfacb,0xf945,0xf841,0xf800,0xf800,0xf800,0xf841,0xf945,0xffdf,0xf79e,0x1082,0x0000,
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	0x0000,0x0000,0x0000,0x0000,0x0000,0x0000,0x0000,0x0000,0x0000,0x0000,0x0000,0x0000,0x0000,0xffdf,0xffdf,0x0000,0x0000,0x0000,0x0000,0x0000,0x0000,0x0000,0x0000,0x0000,0x0000,0x0000,0x0000,0x0000,0x0};

//static long poincareColours[][] = {{1,BLUE},{20,GREEN},{30,YELLOW},{50,RED}};

HeartRateMonitor::HeartRateMonitor(): App() {
	// Keep the constructor empty and do most things in the init()
	m_lastInterval=0;
	m_lastX = 0;
	m_effects = false;
	m_map = NULL;
	m_lastMin = MIN_GUESS;
	m_scaledLastMin = MIN_GUESS;
	m_lastMax = MAX_GUESS;
	m_scaledLastMax = MAX_GUESS;
	m_lastScale = 0.1;
	m_prevCount = 0;
	m_prevPopulated = false;
	logger = loggerFactory.getLogger("HRM");
}
void HeartRateMonitor::init() {
	logger->debug("%s %s LowPulse=%d HighPulse=%d",getName(),INIT,configuration.getLowPulse(),configuration.getHighPulse());
	m_icon = new Icon(28,myicon);
	m_map = new SimpleMap();
}
void HeartRateMonitor::setup() {
	Graphics.fillScreen(WHITE);
	Graphics.setRotation(3);
	Graphics.setTextSize(1);
	Graphics.fillRect(0,0,Graphics.width(),Graphics.height(),WHITE);
	Graphics.setCursor(120,100); // needed?
	m_lastX = 0;
	m_effects = false;

	heartRateInterrupt.reset();
	heartRateInterrupt.setEffects(m_effects);
	m_map->purge();
	initaliseGraph(0, 0);
}
boolean HeartRateMonitor::touch(TS_Point p) {
	m_effects = !m_effects;
	heartRateInterrupt.setEffects(m_effects);
	heartRateInterrupt.reset();
	Graphics.fillRect(0,0,Graphics.width(),Graphics.height(),BLACK);
	delay(25);
	Graphics.fillRect(0,0,Graphics.width(),Graphics.height(),WHITE);
	initaliseGraph(0,0);
	return true;
}
void HeartRateMonitor::figureScale() {
	float minn = MIN_GUESS;
	float maxx = MAX_GUESS;
	int j = (m_prevPopulated?PREV_BUFSIZE:m_prevCount);
	for (int i=0; i < j;i++) {
		maxx = max(maxx,m_prev[i]);
		minn = min(minn,m_prev[i]);
	}
	float denom = maxx - minn;
	if (denom < 0.001) {
		denom = 1;
	}
	m_lastScale = (SCREEN_HEIGHT)/denom;
	m_scaledLastMin = minn;
	m_scaledLastMax = maxx;
}
void HeartRateMonitor::display() {

	// handle the display
	int bpm = heartRateInterrupt.getCurrentBPM();
	float interval = heartRateInterrupt.getLastInterval();
	float lasty = heartRateInterrupt.getLastY();
	m_prev[m_prevCount++] = lasty;
	m_prevCount %= PREV_BUFSIZE;
	if (m_prevCount == 0) {
		m_prevPopulated = true;
		figureScale();
	}
	volatile int y = (lasty-m_scaledLastMin)*m_lastScale;
	if (y <= 0 || y >= (SCREEN_HEIGHT)) {
		figureScale();
		y = (lasty-m_scaledLastMin)*m_lastScale;
	}
	volatile int x = m_lastX++;
	m_lastX %= Graphics.width();
	if (m_lastX == 0) {
		initaliseGraph(bpm,interval);
	}
	y = constrain(y, 0, (SCREEN_HEIGHT));
	Graphics.drawPixel(m_lastX,SCREEN_OFFSET+((SCREEN_HEIGHT)-y),BLACK);
}

void HeartRateMonitor::initaliseGraph(int bpm, float interval) {
	Poincare *poincare = heartRateInterrupt.getPoincare();
	int maxPoincare = poincare->getMax();
	if (logger->isDebug()) {
		logger->debug("initaliseGraph maxPoincare=%d m_intervals",maxPoincare);
		for (int i=0;i<maxPoincare;i++) {
			Serial.print(poincare->get(i));
			Serial.print(",");
		}
		Serial.println();
	}
	logger->debug("m_lastMin=%d m_lastMax=%d bpm=%d m_lastScale=%d",m_lastMin,m_lastMax,bpm,m_lastScale);

	Graphics.fillRect(0,0,150,100,WHITE); // panel #1
	Graphics.fillRect(0,100,Graphics.width(),Graphics.height()-100,WHITE); // panel #2
	Graphics.setCursor(10,20);// panel #1
	uint16_t colour = GREEN;
	if (bpm < configuration.getLowPulse()) {
		colour = BLUE;
	}
	if (bpm > configuration.getHighPulse()) {
		colour = RED;
	}
	Graphics.setTextColor(colour);
	Graphics.setTextSize(2);
	Graphics.print("BPM: ");
	Graphics.print(bpm);
	Graphics.setCursor(10,40);// panel #1
	Graphics.print("INT: ");
	if (interval > 0 && interval < 10000) {
		int i = interval;
		Graphics.print(i);
	}
#ifdef POINCARE
	Graphics.drawRect(160, 0, 160, 100, BLACK);// panel #3
	for (int i=1;i<maxPoincare;i++) {
		float i1 = poincare->get(i-1);
		float i2 = poincare->get(i);
		volatile int y = (i1-800)*0.04;
		volatile int x = 160+((i2-800)*0.025);
		long key = (x*10000)+y;
		int colour = BLACK;
		if (key > 0) {
			int frequency = m_map->put(key);
			if (frequency < 20) {
				colour = BLUE;
			} else if (frequency < 50) {
				colour = GREEN;
			} else if (frequency < 80) {
				colour = YELLOW;
			} else {
				colour = RED;
			}
		}
		Graphics.fillCircle(constrain(x,0,320),constrain(y,0,240),2,colour);
	}
#endif
}

void HeartRateMonitor::close() {
	heartRateInterrupt.reset();
	m_map->dump();
	m_map->purge();
	m_map->dump();
}

HeartRateMonitor::~HeartRateMonitor() {
}

App *heartRateMonitor = new HeartRateMonitor();


