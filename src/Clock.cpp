/*
 * Clock.cpp
 *
 *  Created on: 28/04/2013
 *      Author: roger
 */

#include "Clock.h"

static uint16_t myicon[] PROGMEM = {
	0xa514,0xbdd7,0xb596,0xc618,0x0000,0x0000,0x7bcf,0x0000,0xa514,0x8c51,0xbdd7,0xbdd7,0x9cd3,0xce59,0x9492,0x0000,0x0000,0x0000,0x0000,0x0000,0x0000,0x0000,0x0000,0x0000,0x0000,0x0000,0x0000,0x0000,
	0xffdf,0xffdf,0xffdf,0xffdf,0xffdf,0x0000,0xffdf,0x0000,0xffdf,0xffdf,0xffdf,0xffdf,0xffdf,0xffdf,0x8c51,0xdedb,0xad55,0x0000,0x0000,0x0000,0x0000,0x0000,0x0000,0x0000,0x0000,0x0000,0x0000,0x0000,
	0xffdf,0xffdf,0xffdf,0xffdf,0xffdf,0x0000,0xffdf,0x0000,0xffdf,0xffdf,0xffdf,0xffdf,0xffdf,0xffdf,0x0000,0x0000,0xad55,0xe71c,0x6b4d,0x0000,0x0000,0x0000,0x0000,0x0000,0x0000,0x0000,0x0000,0x0000,
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	0xffdf,0xffdf,0xffdf,0xffdf,0xffdf,0xffdf,0xffdf,0xffdf,0xffdf,0xffdf,0xffdf,0xffdf,0xffdf,0xffdf,0xffdf,0xffdf,0xffdf,0xffdf,0xffdf,0xffdf,0x0000,0xce59,0x0000,0x0000,0xce59,0x0000,0x0000,0x0000,0x0};


Clock::Clock(): App() {
	// Keep the constructor empty and do most things in the init()
	loggerClock = loggerFactory.getLogger("Clock");
}
void Clock::init() {
	m_noise = false;
	m_icon = new Icon(28,myicon);
	m_timeZone = configuration.getTimeZone();
}

void Clock::setup() {
	Graphics.fillScreen(BLACK);
	Graphics.setRotation(3);
	m_buttonOn->draw();
	m_buttonOff->draw();
	m_buttonMars->draw();
}

void Clock::close() {
	m_noise = false;
}

boolean Clock::touch(TS_Point p) {
	if (m_buttonOn->isClicked(p)) {
		m_buttonOn->flash();
		m_noise = false;
	}
	else if (m_buttonOff->isClicked(p)) {
		m_buttonOff->flash();
		m_noise = true;
	}
	else if (m_buttonMars->isClicked(p)) {
		m_buttonMars->flash();
		m_mars = !m_mars;
		m_buttonEarth->draw();
	}
	else if (m_buttonEarth->isClicked(p)) {
		m_buttonEarth->flash();
		m_mars = !m_mars;
		m_buttonMars->draw();
	}
	return true;
}
void Clock::display() {
	if (m_noise) {
		Hardware.playTone(3136,30,40);
		Hardware.playTone(4186,30,9);
		Hardware.blink1();
	}
	Graphics.fillRect(0,0,Graphics.width(),120,BLACK);
	Graphics.setCursor(60,50);
	Graphics.setTextColor(WHITE);
	Graphics.setTextSize(3);
	Graphics.setFont(Arial_20);


	if (m_mars) {
		unsigned long mslong = (unsigned long) now();
		double msdouble = mslong;
		double JDUT = (msdouble / 8.64E4) + 2440587.5F; // A2
		double TT_UTC = 64.184F; // A4
		double JDTT = JDUT + (TT_UTC/86400.0F); // A5
		double MST =  24  * ( ((JDTT - 2451549.5) / 1.0274912517) + 44796.0 - 0.0009626 );
		unsigned long MSTLong = MST;
		double MSTFraction = MST - MSTLong;
		long hours = MSTLong % 24;
		MSTFraction = MSTFraction * 100 * 0.6;
		int minutes = MSTFraction;
		int seconds = (MSTFraction - minutes) * 100 * 0.6;
		Graphics.print(Hardware.timeString(hours,minutes,seconds));
		Graphics.setCursor(50,10);
		Graphics.setFont(Hardware.getDefaultFont());
		Graphics.println("tz Airy-0, Sinus Meridiani");
	} else {
		// Earth time
		long adjustedDate = nz.toLocal(now());
		Graphics.println(Hardware.timeString(adjustedDate));
		Graphics.setCursor(50,100);
		Graphics.println(Hardware.dateString(adjustedDate));
		Graphics.setCursor(50,10);
		Graphics.setFont(Hardware.getDefaultFont());
		Graphics.println("tz Auckland, New Zealand");
	}
}

Clock::~Clock() {
}

App *clock = new Clock();


