/*
 * Notification.cpp
 *
 *  Created on: 28/04/2013
 *      Author: roger
 */

#include "Notification.h"

static uint16_t myicon[] PROGMEM = {
		0x0000,0x0000,0x0000,0x0000,0x0000,0x0000,0x0000,0x0000,0x0000,0x0000,0x0000,0x0000,0x0000,0x0000,0x0000,0x0000,0x0000,0x0000,0x0000,0x0000,0x0000,0x0000,0x0000,0x0000,0x0000,0x0000,0x0000,0x0000,
		0x0000,0x0000,0x0000,0x0000,0x0000,0x0000,0x0000,0x0000,0x0000,0x0000,0x0000,0x0000,0x0000,0x0000,0x0000,0x0000,0x0000,0x0000,0x0000,0x0000,0x0000,0x0000,0x0000,0x0000,0x0000,0x0000,0x0000,0x0000,
		0x0000,0x0000,0x0000,0x0000,0x0000,0x0000,0x0000,0x0000,0x0000,0x0000,0x0000,0x0000,0x0000,0x0000,0x0000,0x0000,0x0000,0x0000,0x0000,0x0000,0x0000,0x0000,0x0000,0x0000,0x0000,0x0000,0x0000,0x0000,
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		0x0000,0x0000,0x0000,0x0000,0x0000,0x0000,0x0000,0x0000,0x0000,0x0000,0x0000,0x0000,0x0000,0x0000,0x0000,0x0000,0x0000,0x0000,0x0000,0x0000,0x0000,0x0000,0x0000,0x0000,0x0000,0x0000,0x0000,0x0000,0x0000};

const char *appname = PSTR("Notification");

Notification::Notification(): App() {
	// Keep the constructor empty and do most things in the init()
	m_rootNotificationInstance = NULL;
	loggerNotification = loggerFactory.getLogger(appname);
}
void Notification::init() {
	loggerNotification->debug("init()");
//	m_icon = new Icon(28,&Notification_bitmap[0]);
	m_icon = new Icon(28,myicon);
	m_rootNotificationInstance = NULL;
	count=0;
}
const char* Notification::getName() {return appname;};

void Notification::setup() {
	loggerNotification->debug("setup()");
	Graphics.fillScreen(BLACK);
	Graphics.setRotation(3);
	Graphics.setCursor(0,Graphics.height()-10);
	Graphics.fillScreen(BLACK);
	Graphics.setRotation(3);
	Graphics.setTextSize(2);
	Graphics.setCursor(0,0);
	NotificationInstance *n = m_rootNotificationInstance;
	if (count == 0) {
		Graphics.println("No notifications");
		return;
	}
	while (n != NULL) {
		Graphics.printf(PSTR("%02d:%02d "),hour(n->m_timeStamp),minute(n->m_timeStamp));
		Graphics.println(n->m_content->c_str());
		n = n->m_next;
	}
	m_icon->reverse(false);
}

const Icon *Notification::getIcon() {
	return m_icon;
};

void Notification::notify(const char *s) {
	setup();
};
void Notification::addMessage(const char *s) {
	loggerNotification->debug("addMessage...[%s]",s);
	if (strncmp(s,"%%",2) == 0) {
		// this is a time set message
		time_t rawtime = strtoul(&s[2],NULL,10);
		setTime(rawtime);
		long adjustedDate = now();
		Teensy3Clock.set(adjustedDate);
		loggerNotification->debug("setting date to [%s]",
			Hardware.dateString(adjustedDate));
		loggerNotification->debug("setting time to [%s]",
			Hardware.timeString(adjustedDate));
		return;
	}
	NotificationInstance *latest;
	if (m_rootNotificationInstance == NULL) {
		m_rootNotificationInstance = new NotificationInstance(s);
		latest = m_rootNotificationInstance;
	} else {
		NotificationInstance *n = findLastNotification(m_rootNotificationInstance);
		latest = new NotificationInstance(s,n);
	}
	count++;
	while (count > MAX_NOTIFICATIONS) {
		NotificationInstance *next = m_rootNotificationInstance->m_next;
		delete m_rootNotificationInstance;
		m_rootNotificationInstance = next;
		count--;
	}
	m_icon->reverse(true);
	Appregistry.getCurrentApp()->notify(s);// This tells the menu to redraw (if the current app is the menu) most apps ignore notify().
	Hardware.blink0();
	Hardware.siren();
};

void Notification::deleteLastNotification(NotificationInstance *n) {
	loggerNotification->debug("deleteLastNotification...");
	if (n->m_next == NULL) {
		return;
	}
	if (n->m_next->m_next == NULL) {
		// This is the last one
		delete n->m_next;
		n->m_next = NULL;
	} else {
		deleteLastNotification(n->m_next);
	}
};
NotificationInstance *Notification::findLastNotification(NotificationInstance *root) {
#ifdef NOTIFICATION_DEBUG
	Serial.println("Notification::findLastNotification...");
#endif
	if (root == NULL) {
		return NULL;
	}
	if (root->m_next == NULL) {
		return root;
	}
	if (root->m_next->m_next == NULL) {
		// This is the last one
		return root->m_next;
	} else {
		return findLastNotification(root->m_next);
	}
}

void Notification::display() {
}

Notification::~Notification() {
}

App *notification = new Notification();


