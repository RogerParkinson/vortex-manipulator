/*
 * Dalek.cpp
 *
 *  Created on: 23/05/2013
 *      Author: roger
 */

#include "Dalek.h"

static uint16_t myicon[] PROGMEM = {
	0x0000,0x0000,0x0000,0x0000,0x0000,0x0000,0x0000,0x0000,0x3186,0x5acb,0x1987,0x0000,0x0000,0x0000,0x0000,0x2945,0x4208,0xad55,0xce59,0xdedb,0x9492,0x6b4d,0x0000,0x0000,0x0000,0x0000,0x0000,0x0000,
	0x0000,0x0000,0x0000,0x0000,0x0000,0x0000,0x0000,0x0000,0x18c3,0x3186,0x3acd,0x528a,0x528a,0x528a,0x630c,0x9cd3,0xad55,0xb596,0xdedb,0xc618,0xe71c,0xd69a,0xa514,0x3186,0x0000,0x0000,0x0000,0x0000,
	0x0000,0x0000,0x0000,0x0000,0x0000,0x0000,0x0000,0x0000,0x0000,0x528a,0x0000,0x0000,0x0000,0x0000,0xad55,0xb596,0xc618,0xdedb,0xef5d,0xffdf,0xef5d,0xd69a,0xc618,0x8c51,0x0000,0x0000,0x0000,0x0000,
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	0x0000,0x0000,0x0000,0x0000,0x2945,0xffdf,0xffdf,0xffdf,0xffdf,0xffdf,0xffdf,0xffdf,0xffdf,0xffdf,0xffdf,0xffdf,0xffdf,0xffdf,0xffdf,0xffdf,0xffdf,0xffdf,0xffdf,0xffdf,0xffdf,0xffdf,0xffdf,0xffdf,0x0};


Dalek::Dalek() {
	currentColour = BLUE;
	circleSize = 1;
	m_width = Graphics.width();
	m_height = Graphics.height();
	m_cy = Graphics.height() / 2;
	m_cx = Graphics.width() / 2;
}
void Dalek::init() {
#ifdef DEBUG_DALEK
	Serial.print(getName());Serial.println(INIT);
#endif
	m_icon = new Icon(28,myicon);
	m_height = Graphics.height();
	m_width = Graphics.width();
	m_cy = Graphics.height() / 2;
	m_cx = Graphics.width() / 2;
	currentColour = BLUE;
	circleSize = 1;
}
void Dalek::setup() {
#ifdef DEBUG_DALEK
	Serial.println(PSTR("Dalek setup"));
#endif
	Graphics.fillScreen(BLACK);
	Graphics.setRotation(0);
	Graphics.setCursor(0,0);
	m_height = Graphics.height();
	m_width = Graphics.width();
	m_cy = Graphics.height() / 2;
	m_cx = Graphics.width() / 2;
	srand (0);
	for (unsigned int i=0;i<DALEK_COUNT;i++) {
		daleks[i] = NULL;
	}
	lastx = Hardware.getAccelerometerValues().x;
}
void Dalek::display() {
	Graphics.drawCircle(m_cx,m_cy,RADIUS*circleSize,BLACK);
	if (++circleSize > 8) {
		circleSize = 1;
		int x = Hardware.getAccelerometerValues().x;
		int deltaX = abs(x-lastx);
#ifdef DEBUG_DALEK
		Serial.print(PSTR("Dalek display"));
		Serial.print(PSTR(" x="));
		Serial.print(x);
		Serial.print(PSTR(" deltaX="));
		Serial.print(deltaX);
		Serial.print(PSTR(" SENSITIVITY="));
		Serial.println(SENSITIVITY);
#endif
		lastx = x;
		// if the x axis has moved then attempt to generate a dalek in one of the free slots
		if (deltaX > SENSITIVITY) {
			for (unsigned int i=0;i<DALEK_COUNT;i++) {
				if (daleks[i] == NULL) {
					daleks[i] = new DalekInstance(10+(rand() % (m_width-20)),10+(rand() % (m_height-20)),rand() % 5000000L, &m_smallIcon);
					break;
				}
			}
		}
	}
	for (unsigned int i=0;i<DALEK_COUNT;i++) {
		DalekInstance *d = daleks[i];
		if (d != NULL) {
			if (d->getVanishTime() < micros()) {
				d->erase();
				delete d;
				daleks[i] = NULL;
			}
		}
	}
	if (circleSize == 1) {
		int dalekCounter=0;
		for (unsigned int i=0;i<DALEK_COUNT;i++) {
			if (daleks[i] != NULL) {
				dalekCounter++;
			}
		}
		if (dalekCounter > 0) {
			Hardware.siren();
		}
#ifdef DEBUG_DALEK
		Serial.print(PSTR("dalekCounter "));
		Serial.println(dalekCounter);
#endif
	}
	Graphics.drawCircle(m_cx,m_cy,RADIUS*circleSize,currentColour);
}

Dalek::~Dalek() {
}

App *dalek = new Dalek();
